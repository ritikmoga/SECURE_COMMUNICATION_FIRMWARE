## main/Kconfig.projbuild
```kconfig
menu "Secure Communication Firmware"

config SCF_WIFI_SSID
    string "Wi-Fi SSID"
    default ""

config SCF_WIFI_PASSWORD
    string "Wi-Fi password"
    default ""

config SCF_RELAY_HOST
    string "Relay hostname or IP"
    default "192.168.1.10"

config SCF_RELAY_PORT
    int "Relay TLS port"
    range 1 65535
    default 7443

config SCF_NTP_SERVER
    string "NTP server used before TLS certificate validation"
    default "pool.ntp.org"

config SCF_TIME_SYNC_TIMEOUT_SECONDS
    int "Initial time synchronization timeout (seconds)"
    range 5 120
    default 30

config SCF_TLS13_ONLY
    bool "Require TLS 1.3"
    default y

config SCF_OTA_URL
    string "Default HTTPS OTA URL"
    default ""

config SCF_MAX_MESSAGE_BYTES
    int "Maximum plaintext message bytes"
    range 32 1024
    default 256

endmenu
```

## sdkconfig.defaults
```kconfig
CONFIG_PARTITION_TABLE_CUSTOM=y
CONFIG_PARTITION_TABLE_CUSTOM_FILENAME="partitions.csv"
CONFIG_BOOTLOADER_APP_ROLLBACK_ENABLE=y
CONFIG_ESP_MAIN_TASK_STACK_SIZE=8192
CONFIG_MBEDTLS_SSL_PROTO_TLS1_2=y
CONFIG_MBEDTLS_SSL_PROTO_TLS1_3=y
CONFIG_MBEDTLS_HKDF_C=y
CONFIG_MBEDTLS_GCM_C=y
CONFIG_MBEDTLS_ECDH_C=y
CONFIG_MBEDTLS_ECDSA_C=y
CONFIG_MBEDTLS_PEM_PARSE_C=y
CONFIG_MBEDTLS_PK_PARSE_C=y
```
